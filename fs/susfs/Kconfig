## fs/susfs/Kconfig
```kconfig
# SUSFS Kconfig — provided externally (RKSU driver has no susfs Kconfig)
# Pair with the in-tree fs/susfs.c / include/linux/susfs.h (susfs 1.5.x set).

config KSU_SUSFS
	bool "SUSFS"
	depends on KSU
	default y
	help
	  SUSFS support (SuSFS for KernelSU).

config KSU_SUSFS_SUS_PATH
	bool "SUS_PATH"
	depends on KSU_SUSFS
	default y

config KSU_SUSFS_SUS_MOUNT
	bool "SUS_MOUNT"
	depends on KSU_SUSFS
	default y

config KSU_SUSFS_SUS_KSTAT
	bool "SUS_KSTAT"
	depends on KSU_SUSFS
	default y

config KSU_SUSFS_TRY_UMOUNT
	bool "TRY_UMOUNT"
	depends on KSU_SUSFS
	default n

config KSU_SUSFS_SPOOF_UNAME
	bool "SPOOF_UNAME"
	depends on KSU_SUSFS
	default y

config KSU_SUSFS_ENABLE_LOG
	bool "ENABLE_LOG"
	depends on KSU_SUSFS
	default y

config KSU_SUSFS_HIDE_KSU_SUSFS_SYMBOLS
	bool "HIDE_KSU_SUSFS_SYMBOLS"
	depends on KSU_SUSFS
	default y

config KSU_SUSFS_SPOOF_CMDLINE_OR_BOOTCONFIG
	bool "SPOOF_CMDLINE_OR_BOOTCONFIG"
	depends on KSU_SUSFS
	default y

config KSU_SUSFS_OPEN_REDIRECT
	bool "OPEN_REDIRECT"
	depends on KSU_SUSFS
	default y

config KSU_SUSFS_SUS_MAP
	bool "SUS_MAP"
	depends on KSU_SUSFS
	default y
```
